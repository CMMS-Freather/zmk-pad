## config/boards/shields/zmk_pad/Kconfig.defconfig
```kconfig
# Copyright (c) 2020 The ZMK Contributors
# SPDX-License-Identifier: MIT

if SHIELD_ZMK_PAD

config ZMK_KEYBOARD_NAME
    default "zmk_pad"

endif
```

## config/boards/shields/zmk_pad/Kconfig.shield
```kconfig
# Copyright (c) 2020 The ZMK Contributors
# SPDX-License-Identifier: MIT

config SHIELD_ZMK_PAD
    def_bool $(shields_list_contains,zmk_pad)
```
